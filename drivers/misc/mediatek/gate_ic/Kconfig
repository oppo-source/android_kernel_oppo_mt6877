## drivers/misc/mediatek/gate_ic/Kconfig
```kconfig
config RT4831A_I2C
	bool "Support rt4831 gate ic board"
	---help---
	  I2C gate driver for RT4831 support.
	  Set y to support.
	  Set n to disable.
	  RT4831 I2C driver for display and backlight.

config OCP2130_I2C
	bool "Support ocp2130 gate ic board"
	---help---
	  I2C gate driver for OCP2130 support.
	  Set y to support.
	  Set n to disable.
	  OCP2130 I2C driver for display bias.
```

## drivers/misc/mediatek/sensor/2.0/oplus_virtual_sensor/sensors/face_down_detecthub/Kconfig
```kconfig
config OPLUS_FEATURE_FACE_DOWN_DETECT
	bool "face_down_detecthub for MediaTek package"
	default n
```

## drivers/misc/mediatek/sensor/2.0/oplus_virtual_sensor/sensors/sensor_monitor/Kconfig
```kconfig
config OPLUS_FEATURE_SENSOR_MONITOR
	bool "sensor_monitor for MediaTek package"
	default y
```

## drivers/misc/mediatek/sensors-1.0/rear_als/Kconfig
```kconfig
config CUSTOM_KERNEL_REAR_ALS
	bool "CUSTOM KERNEL REAR ALS Config"
	help
	  one load to support different rear_als sensor.
	  This feature Option is used for projects which using more than one
	  rear_als, and be auto detected by setting this option to yes
	  If unsure, say N.

source "drivers/misc/mediatek/sensors-1.0/rear_als/rear_alshub/Kconfig"
```

## drivers/misc/mediatek/sensors-1.0/rear_als/rear_alshub/Kconfig
```kconfig
config MTK_REAR_ALSHUB
	bool "MTK REAR ALSHUB Config"
	help
	  It support different rear alshub sensor.
	  If this option is set,
	  it will support
	  sensorhub rear als.
```

## drivers/misc/mediatek/sensors-1.0/rear_flicker/Kconfig
```kconfig
config CUSTOM_KERNEL_REAR_FLICKER
	bool "CUSTOM KERNEL SENSOR REAR FLICKER config"
	help
	one load to support different rear_flicker sensor.
	This feature Option is used for projects which using
	rear_flicker, and be auto detected by setting this option to yes
	If unsure, say N.

source "drivers/misc/mediatek/sensors-1.0/rear_flicker/rear_flickerhub/Kconfig"
```

## drivers/misc/mediatek/sensors-1.0/rear_flicker/rear_flickerhub/Kconfig
```kconfig
config MTK_REAR_FLICKERHUB
	bool "MTK REAR FLICKERHUB Config"
	help
	  It support rear flickerhub sensor.
	  If this option is set,
	  it will support
	  sensorhub rear flicker.
```

## drivers/soc/Kconfig
```kconfig
menu "SOC (System On Chip) specific Drivers"

source "drivers/soc/actions/Kconfig"
source "drivers/soc/amlogic/Kconfig"
source "drivers/soc/atmel/Kconfig"
source "drivers/soc/bcm/Kconfig"
source "drivers/soc/fsl/Kconfig"
source "drivers/soc/imx/Kconfig"
source "drivers/soc/mediatek/Kconfig"
source "drivers/soc/qcom/Kconfig"
source "drivers/soc/renesas/Kconfig"
source "drivers/soc/rockchip/Kconfig"
source "drivers/soc/samsung/Kconfig"
source "drivers/soc/sunxi/Kconfig"
source "drivers/soc/tegra/Kconfig"
source "drivers/soc/ti/Kconfig"
source "drivers/soc/ux500/Kconfig"
source "drivers/soc/versatile/Kconfig"
source "drivers/soc/zte/Kconfig"
#ifdef VENDOR_EDIT
source "drivers/soc/oppo/Kconfig"
#endif /*VENDOR_EDIT*/
#ifdef OPLUS_FEATURE_IOMONITOR
source "drivers/soc/oplus/iomonitor/Kconfig"
#endif /*OPLUS_FEATURE_IOMONITOR*/
#ifdef VENDOR_EDIT
source "drivers/soc/oplus/system/Kconfig"
#endif /* VENDOR_EDIT */

#ifdef VENDOR_EDIT
source "drivers/soc/oppo/Kconfig"
#endif /*VENDOR_EDIT*/
#ifdef OPLUS_FEATURE_HEALTHINFO
source "drivers/soc/oplus/healthinfo/Kconfig"
#endif /*OPLUS_FEATURE_HEALTHINFO*/

#ifdef OPLUS_FEATURE_LOWMEM_DBG
source "drivers/soc/oplus/lowmem_dbg/Kconfig"
##endif /* OPLUS_FEATURE_LOWMEM_DBG */

#ifdef OPLUS_FEATURE_MEMLEAK_DETECT
source "drivers/soc/oplus/svelte/Kconfig"
#endif /* OPLUS_FEATURE_MEMLEAK_DETECT */

#Add for NandSwap
source "drivers/soc/oplus/oplus_nandswap/Kconfig"

#ifdef OPLUS_FEATURE_MIDAS
source "drivers/soc/oplus/midas/Kconfig"
#endif

#ifdef OPLUS_FEATURE_RT_INFO
source "drivers/soc/oplus/rt_info/Kconfig"
#endif


endmenu
```

## drivers/soc/oppo/Kconfig
```kconfig
#ifdef OPLUS_FEATURE_TP_BASIC
config OPPO_ARCH_FILE
    bool "for build directory oppo"
    ---help---
    say Y to buid in
source "drivers/soc/oppo/oppo_devinfo/Kconfig"


source "drivers/soc/oppo/oppo_devinfo/Kconfig"
#source "drivers/soc/oppo/oppo_als_cali_value/Kconfig"
#source "drivers/soc/oppo/oppo_hypnus/Kconfig"
#//Wen.Luo@BSP
#source "drivers/soc/oppo/oppo_shutdown_detect/Kconfig"

#source "drivers/soc/oppo/oppo_phoenix/Kconfig"
#endif /* OPLUS_FEATURE_TP_BASIC */

#ifdef VENDOR_EDIT
#source "drivers/soc/oppo/oppo_key_handle/Kconfig"
#endif /* VENDOR_EDIT */

#ifdef OPLUS_FEATURE_SENSOR_SMEM
source "drivers/soc/oppo/oppo_als_cali_value/Kconfig"
#endif /*OPLUS_FEATURE_SENSOR_SMEM */
```
