/**********************************************************************************
* Copyright (c)  2008-2020  Guangdong oplus Mobile Comm Corp., Ltd
*
***********************************************************************************/
&odm {
    nfc_chipset:nfc_chipset {
        compatible = "oplus-nfc-chipset";
        chipset-23704 = "PN557";
        manifest = "/odm/etc/vintf/manifest_nfc_pn557.xml";
    };
};

&i2c3 {
       status = "okay";
       clock-frequency = <400000>;
       nq@28 {
               compatible = "nxp,pn553";
               reg = <0x28>;
               nxp,pn544-irq = <&pio 6 0x0>;
               nxp,pn544-ven = <&pio 8 0x0>;
               nxp,pn544-fw-dwnld = <&pio 19 0x0>;
               nxp,pn544-clkreq = <&pio 11 0x0>;
               interrupt-parent = <&pio>;
       };
};
