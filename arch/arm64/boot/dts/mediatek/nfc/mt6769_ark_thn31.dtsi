/**********************************************************************************
* Copyright (c)  2008-2020  Guangdong oplus Mobile Comm Corp., Ltd
*
***********************************************************************************/
&odm {
        nfc_chipset:nfc_chipset {
                compatible = "oplus-nfc-chipset";
                chipset-23704 = "THN31";
                manifest = "/odm/etc/vintf/manifest_nfc_thn31.xml";
        };
};


&i2c3 {
       status = "okay";
       clock-frequency = <400000>;

       tms_thn31@28 {
               compatible = "tms,nfc";
               reg = <0x28>;
               tms,irq-gpio = <&pio 6 0x0>;
               tms,ven-gpio = <&pio 8 0x1>;
               tms,download-gpio = <&pio 19 0x0>;
               //pn544-clkreq = <&pio 11 0x0>;
               interrupt-parent = <&pio>;
       };
};

