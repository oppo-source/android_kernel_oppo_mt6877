&odm  {
	oplus_devinfo:oplus_devinfo {
	compatible = "oppo-devinfo";
	main-sub {
		compatible = "hw-match, main-sub";
		aboard-patterns = <0 0>;
		/*main board*/
		match-projects = <20255 20257>;
	};
	};
};
&lk_charger{
	charger_by_buckboost;
	support_tuv_authentication;
};
